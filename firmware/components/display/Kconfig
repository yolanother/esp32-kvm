## firmware/components/display/Kconfig
```kconfig
# Copyright (c) ESP32 KVM contributors. Use of this file is governed by the root LICENSE.
# Gates the on-board Waveshare ST7789 panel behind explicit physical profile verification.
# The default leaves LCD pins untouched while the BOOT emergency button still operates.
menu "ESP32 KVM device screen"

    config KVM_DISPLAY_WAVESHARE_TOUCH_154_VERIFIED
        bool "Enable the validated Waveshare ESP32-S3-Touch-LCD-1.54 panel"
        default n
        help
            Select only after verifying the board model and PCB revision against
            the Waveshare schematic and performing the staged panel bring-up in
            docs/Designs/device-screens/screen-state.md. This enables ST7789 SPI
            and GPIO46 backlight output. The default keeps the panel off while
            preserving BOOT emergency sampling and USB/BLE routing.

    config KVM_DISPLAY_CST816_TOUCH_VERIFIED
        bool "Enable physically validated CST816 touch for on-device pairing"
        depends on KVM_DISPLAY_WAVESHARE_TOUCH_154_VERIFIED
        default n
        help
            Select only after validating CST816 I2C pins, touch orientation,
            and button hit regions on this PCB revision. Default-off touch
            prevents an unvalidated press from approving a BLE challenge.

endmenu
```

## firmware/components/hid/Kconfig
```kconfig
config KVM_HID_KEYBOARD_ONLY_DIAGNOSTIC
    bool "Expose keyboard-only HID for host compatibility diagnosis"
    default n
    help
        Temporarily remove mouse and consumer reports and characteristics to
        isolate host HID registration failures. This mode is not a KVM release.

config KVM_HID_GATT_TRACE
    bool "Log HID GATT access for host registration diagnosis"
    default n
    help
        Log attribute IDs, operations, subscriptions, and notification results.
        Do not enable in a release build.
```

## firmware/sdkconfig.defaults
```kconfig
# ESP32 KVM baseline target; board revision and peripheral pins require verification before use.
CONFIG_IDF_TARGET="esp32s3"
CONFIG_ESPTOOLPY_FLASHSIZE_16MB=y
CONFIG_ESP_CONSOLE_SECONDARY_NONE=y
CONFIG_PARTITION_TABLE_CUSTOM=y
CONFIG_PARTITION_TABLE_CUSTOM_FILENAME="partitions.csv"
CONFIG_BT_ENABLED=y
CONFIG_BT_BLUEDROID_ENABLED=n
CONFIG_BT_NIMBLE_ENABLED=y
CONFIG_BT_NIMBLE_ROLE_PERIPHERAL=y
CONFIG_BT_NIMBLE_GATT_SERVER=y
CONFIG_BT_NIMBLE_SECURITY_ENABLE=y
CONFIG_BT_NIMBLE_SM_SC=y
CONFIG_BT_NIMBLE_NVS_PERSIST=y
CONFIG_BT_NIMBLE_MAX_CONNECTIONS=3
CONFIG_BT_NIMBLE_MAX_BONDS=8
CONFIG_BT_NIMBLE_MAX_CCCDS=24
CONFIG_BT_CTRL_BLE_MAX_ACT=4
CONFIG_BT_NIMBLE_MEM_ALLOC_MODE_INTERNAL=y
CONFIG_LV_FONT_MONTSERRAT_28=y
```
